#include "blair-qrd.dtsi"
#include "../larry/nfc/larry-22872-nfc-pn557.dtsi"

&qupv3_se10_i2c {
    status = "ok";
    #address-cells = <1>;
    #size-cells = <0>;

    nq@2A {
        compatible = "nxp,pn544";
        reg = <0x2A>;
        nxp,pn544-irq = <&tlmm 9 0x00>;
        nxp,pn544-ven = <&tlmm 141 0x00>;
        nxp,pn544-fw-dwnld = <&tlmm 8 0x00>;
        qcom,nq-clkreq = <&tlmm 7 0x00>;
        interrupt-parent = <&tlmm>;
        interrupts = <9 0>;
        interrupt-names = "nfc_irq";
        pinctrl-names = "nfc_active", "nfc_suspend";
        pinctrl-0 = <&nfc_int_active &nfc_enable_active>;
        pinctrl-1 = <&nfc_int_suspend &nfc_enable_suspend>;
    };
};
